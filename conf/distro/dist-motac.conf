## conf/distro/dist-motac.conf
```bitbake
DISTRO = "dist-motac"
DISTRO_NAME = "MOTAC Distro"
DISTRO_VERSION = "5.0.5"
DISTRO_CODENAME = "scarthgap"

LOCALCONF_VERSION = "2"
##TCLIBCAPPEND = ""

INIT_MANAGER = "sysvinit"

DISTRO_FEATURES = " \
  opengl \
  vulkan \
  wayland \
  zeroconf \
"
DEV_USER = "erdal"



#DISTRO_FEATURES_BACKFILL_CONSIDERED = " \
# pulseaudio \
#"


IMAGE_LINGUAS:remove = "en-gb"
##GLIBC_GENERATE_LOCALES = "tr_TR.UTF-8 en_US.UTF-8"
IMAGE_FSTYPES = "wic wic.bmap"

##SDK_VENDOR = "-pokysdk"
##SDK_VERSION = "${@d.getVar('DISTRO_VERSION').replace('snapshot-${METADATA_REVISION}', 'snapshot')}"
##SDK_VERSION[vardepvalue] = "${SDK_VERSION}"
##SDK_NAME = "${DISTRO}-${TCLIBC}-${SDKMACHINE}-${IMAGE_BASENAME}-${TUNE_PKGARCH}-${MACHINE}"
##SDKPATHINSTALL = "/opt/${DISTRO}/${SDK_VERSION}"
```

## conf/layer.conf
```bitbake
# We have a conf and classes directory, add to BBPATH
BBPATH .= ":${LAYERDIR}"

# We have recipes-* directories, add to BBFILES
BBFILES += "${LAYERDIR}/recipes-*/*/*.bb \
            ${LAYERDIR}/recipes-*/*/*.bbappend"

BBFILE_COLLECTIONS += "meta-motac"
BBFILE_PATTERN_meta-motac = "^${LAYERDIR}/"
BBFILE_PRIORITY_meta-motac = "6"

LAYERDEPENDS_meta-motac = "core"
LAYERSERIES_COMPAT_meta-motac = "scarthgap"
```
